## boards/shields/m3rdmutation/Kconfig.defconfig
```kconfig
if SHIELD_M3RDMUTATION

# Name must be less than 16 characters long!
config ZMK_KEYBOARD_NAME
    default "m3rdmutation"

CONFIG_ZMK_BATTERY_REPORTING=y
CONFIG_ZMK_POINTING=y

endif
```
